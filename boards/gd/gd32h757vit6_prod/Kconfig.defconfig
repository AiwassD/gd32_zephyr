## boards/gd/gd32h757vit6_prod/Kconfig.defconfig
```kconfig
# Copyright (c) 2026 GigaDevice Semiconductor Inc.
# SPDX-License-Identifier: Apache-2.0

if BOARD_GD32H757VIT6_PROD

config BOARD
	default "gd32h757vit6_prod"

endif # BOARD_GD32H757VIT6_PROD
```

## boards/gd/gd32h757vit6_prod/Kconfig.gd32h757vit6_prod
```kconfig
# Copyright (c) 2026 GigaDevice Semiconductor Inc.
# SPDX-License-Identifier: Apache-2.0

config BOARD_GD32H757VIT6_PROD
	select SOC_GD32H757
```

## boards/gd/gd32h757vit6_prod/board.yml
```yaml
board:
  name: gd32h757vit6_prod
  full_name: GD32H757VIT6-PROD
  vendor: gd
  socs:
    - name: gd32h757
```

## boards/gd/gd32h757zmt6_dev/Kconfig.defconfig
```kconfig
# Copyright (c) 2026 GigaDevice Semiconductor Inc.
# SPDX-License-Identifier: Apache-2.0

if BOARD_GD32H757ZMT6_DEV

config BOARD
	default "gd32h757zmt6_dev"

endif # BOARD_GD32H757ZMT6_DEV
```

## boards/gd/gd32h757zmt6_dev/Kconfig.gd32h757zmt6_dev
```kconfig
# Copyright (c) 2026 GigaDevice Semiconductor Inc.
# SPDX-License-Identifier: Apache-2.0

config BOARD_GD32H757ZMT6_DEV
	select SOC_GD32H757
```

## boards/gd/gd32h757zmt6_dev/board.yml
```yaml
board:
  name: gd32h757zmt6_dev
  full_name: GD32H757ZMT6-DEV
  vendor: gd
  socs:
    - name: gd32h757
```

## drivers/adc/Kconfig.gd32_freerun
```kconfig
# Copyright (c) 2026 HyperStrike
# SPDX-License-Identifier: Apache-2.0

config HS2_GD32_ADC_FREERUN
	bool "GD32H7 free-running dual-ADC analog front-end"
	default y
	depends on DT_HAS_HS2_GD32_ADC_FREERUN_ENABLED
	select DMA
	select PINCTRL
	help
	  Free-running ADC0/ADC1 + cyclic DMA analog sampler with a
	  latest-frame snapshot read. Used by the HS2 analog stick driver.
	  Bypasses the Zephyr ADC request/response framework.
```

## dts/bindings/adc/hs2,gd32-adc-freerun.yaml
```yaml
# Copyright (c) 2026 HyperStrike
# SPDX-License-Identifier: Apache-2.0

description: |
  GD32H7 free-running 3-ADC analog front-end. Owns three ADC instances
  (referenced via the adcs phandles, which should themselves be disabled so
  the standard gd,gd32-adc driver does not also claim them) and runs each in
  scan + continuous mode with a cyclic DMA stream. Exposes a latest-frame
  snapshot read instead of the Zephyr ADC request/response API.

compatible: "hs2,gd32-adc-freerun"

include: [base.yaml, pinctrl-device.yaml]

properties:
  adcs:
    type: phandles
    required: true
    description: ADC0, ADC1, ADC2 nodes (reg/clocks/resets are read from them).

  dmas:
    type: phandle-array
    required: true
    description: DMA spec for adc0, adc1, adc2 (via dmamux).

  dma-names:
    type: string-array
    required: true

  adc0-channels:
    type: array
    required: true
    description: 2 channel numbers on ADC0 (LX, LY).

  adc1-channels:
    type: array
    required: true
    description: 2 channel numbers on ADC1 (RX, RY).

  adc2-channels:
    type: array
    required: true
    description: 2 channel numbers on ADC2 (L2, R2).

  resolutions:
    type: array
    required: true
    description: per-ADC resolution in adcs order (e.g. <14 14 12>; ADC2 max 12).

  frames:
    type: int
    default: 4
    description: ring depth in frames (one frame = 2 ranks).
```

## dts/bindings/usb/gd,gd32-usbhs.yaml
```yaml
# Copyright (c) 2026 HyperStrike
# SPDX-License-Identifier: Apache-2.0

description: |
  GigaDevice GD32 USBHS controller (Synopsys DWC2 IP with embedded HS PHY).

  Bound by the generic Zephyr DWC2 UDC driver via the "snps,dwc2" compatible.
  The "gd,gd32-usbhs" compatible is reserved to select the GD32 vendor quirks
  glue (clock / USB PLL / PHY regulator) once that glue is implemented.

compatible: "gd,gd32-usbhs"

include:
  - snps,dwc2.yaml

properties:
  clocks:
    type: phandle-array
    required: true

  ghwcfg3:
    type: int
    description: |
      Value of the GHWCFG3 register. The GD32 USBHS core does not expose the
      GHWCFG hardware-configuration registers (they read back as zero), so the
      driver falls back to the devicetree ghwcfg1/2/3/4 values. GHWCFG3 carries
      the device FIFO depth (DFIFODEPTH) and the packet/transfer counter widths.
```
